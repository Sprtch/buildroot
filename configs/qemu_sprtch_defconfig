## configs/qemu_sprtch_defconfig
```kconfig
BR2_arm=y
BR2_TOOLCHAIN_BUILDROOT_GLIBC=y
BR2_PACKAGE_HOST_LINUX_HEADERS_CUSTOM_5_4=y
BR2_PACKAGE_GLIBC_UTILS=y
BR2_TARGET_GENERIC_GETTY_PORT="ttyAMA0"
BR2_SYSTEM_DHCP="eth0"
BR2_ROOTFS_OVERLAY="$(BR2_EXTERNAL_sprtch_PATH)/board/sprtch/rootfs_overlay"
BR2_ROOTFS_POST_IMAGE_SCRIPT="board/qemu/post-image.sh"
BR2_ROOTFS_POST_SCRIPT_ARGS="$(BR2_DEFCONFIG)"
BR2_LINUX_KERNEL=y
BR2_LINUX_KERNEL_CUSTOM_VERSION=y
BR2_LINUX_KERNEL_CUSTOM_VERSION_VALUE="5.4.58"
BR2_LINUX_KERNEL_USE_CUSTOM_CONFIG=y
BR2_LINUX_KERNEL_CUSTOM_CONFIG_FILE="board/qemu/arm-versatile/linux.config"
BR2_LINUX_KERNEL_DTS_SUPPORT=y
BR2_LINUX_KERNEL_INTREE_DTS_NAME="versatile-pb"
BR2_PACKAGE_GIT=y
BR2_PACKAGE_PYTHON3=y
BR2_PACKAGE_PYTHON3_SQLITE=y
BR2_PACKAGE_PYTHON_AIOCONSOLE=y
BR2_PACKAGE_PYTHON_ASYNC_TIMEOUT=y
BR2_PACKAGE_PYTHON_ATTRS=y
BR2_PACKAGE_PYTHON_CHARDET=y
BR2_PACKAGE_PYTHON_DAEMONIZE=y
BR2_PACKAGE_PYTHON_FLASK_SQLALCHEMY=y
BR2_PACKAGE_PYTHON_GUNICORN=y
BR2_PACKAGE_PYTHON_MELD3=y
BR2_PACKAGE_PYTHON_PIP=y
BR2_PACKAGE_PYTHON_PYCARES=y
BR2_PACKAGE_PYTHON_PYYAML=y
BR2_PACKAGE_PYTHON_YARL=y
BR2_PACKAGE_POSTGRESQL=y
BR2_PACKAGE_REDIS=y
BR2_PACKAGE_AVAHI=y
BR2_PACKAGE_AVAHI_DAEMON=y
BR2_PACKAGE_AVAHI_LIBDNSSD_COMPATIBILITY=y
BR2_PACKAGE_DROPBEAR=y
BR2_PACKAGE_IPTABLES=y
BR2_PACKAGE_IW=y
BR2_PACKAGE_NGINX=y
BR2_PACKAGE_OPENSSH=y
BR2_TARGET_ROOTFS_EXT2=y
BR2_TARGET_ROOTFS_EXT2_SIZE="256M"
# BR2_TARGET_ROOTFS_TAR is not set
BR2_PACKAGE_HOST_QEMU=y
BR2_PACKAGE_HOST_QEMU_SYSTEM_MODE=y
BR2_PACKAGE_PYTHON_EVDEV=y
BR2_PACKAGE_PYTHON_FLASK_SCRIPT=y
BR2_PACKAGE_HURON=y
BR2_PACKAGE_VICTORIA=y
```

## configs/sprtch_defconfig
```kconfig
BR2_arm=y
BR2_cortex_a53=y
BR2_ARM_FPU_NEON_VFPV4=y
BR2_CCACHE=y
BR2_TOOLCHAIN_BUILDROOT_GLIBC=y
BR2_PACKAGE_HOST_LINUX_HEADERS_CUSTOM_5_4=y
BR2_PACKAGE_GLIBC_UTILS=y
BR2_TOOLCHAIN_BUILDROOT_CXX=y
BR2_TARGET_GENERIC_HOSTNAME="rpi"
BR2_TARGET_GENERIC_ISSUE="Welcome to RPI"
BR2_ROOTFS_DEVICE_CREATION_DYNAMIC_EUDEV=y
BR2_ROOTFS_MERGED_USR=y
BR2_TARGET_GENERIC_ROOT_PASSWD="root"
BR2_SYSTEM_BIN_SH_BASH=y
BR2_SYSTEM_DHCP="eth0"
BR2_TARGET_TZ_INFO=y
BR2_GLOBAL_PATCH_DIR="$BR2_EXTERNAL_sprtch_PATH/patches/"
BR2_ROOTFS_OVERLAY="$BR2_EXTERNAL_sprtch_PATH/board/sprtch/rootfs_overlay"
BR2_ROOTFS_POST_BUILD_SCRIPT="$BR2_EXTERNAL_sprtch_PATH/board/sprtch/post-build.sh"
BR2_ROOTFS_POST_IMAGE_SCRIPT="$BR2_EXTERNAL_sprtch_PATH/board/sprtch/post-image.sh"
BR2_ROOTFS_POST_SCRIPT_ARGS="--add-miniuart-bt-overlay"
BR2_LINUX_KERNEL=y
BR2_LINUX_KERNEL_CUSTOM_TARBALL=y
BR2_LINUX_KERNEL_CUSTOM_TARBALL_LOCATION="$(call github,raspberrypi,linux,1c64f4bc22811d2d371b271daa3fb27895a8abdd)/linux-1c64f4bc22811d2d371b271daa3fb27895a8abdd.tar.gz"
BR2_LINUX_KERNEL_DEFCONFIG="bcm2709"
BR2_LINUX_KERNEL_DTS_SUPPORT=y
BR2_LINUX_KERNEL_INTREE_DTS_NAME="bcm2710-rpi-3-b bcm2710-rpi-3-b-plus bcm2710-rpi-cm3"
BR2_LINUX_KERNEL_NEEDS_HOST_OPENSSL=y
BR2_PACKAGE_BUSYBOX_SHOW_OTHERS=y
BR2_PACKAGE_GIT=y
BR2_PACKAGE_RPI_FIRMWARE=y
BR2_PACKAGE_RPI_FIRMWARE_X=y
BR2_PACKAGE_RPI_WIFI_FIRMWARE=y
BR2_PACKAGE_PYTHON3=y
BR2_PACKAGE_PYTHON3_SQLITE=y
BR2_PACKAGE_PYTHON_AIOCONSOLE=y
BR2_PACKAGE_PYTHON_AIOHTTP_CORS=y
BR2_PACKAGE_PYTHON_AIOHTTP_JINJA2=y
BR2_PACKAGE_PYTHON_EVDEV=y
BR2_PACKAGE_PYTHON_FLASK_SQLALCHEMY=y
BR2_PACKAGE_PYTHON_PIP=y
BR2_PACKAGE_PYTHON_PYYAML=y
BR2_PACKAGE_PYTHON_REDIS=y
BR2_PACKAGE_REDIS=y
BR2_PACKAGE_LIBCAP=y
BR2_PACKAGE_LIBEVDEV=y
BR2_PACKAGE_AVAHI=y
BR2_PACKAGE_AVAHI_DAEMON=y
BR2_PACKAGE_AVAHI_LIBDNSSD_COMPATIBILITY=y
BR2_PACKAGE_CUPS=y
BR2_PACKAGE_CUPS_FILTERS=y
BR2_PACKAGE_DROPBEAR=y
BR2_PACKAGE_IPTABLES=y
BR2_PACKAGE_IW=y
BR2_PACKAGE_NGINX=y
BR2_PACKAGE_OPENSSH=y
BR2_PACKAGE_WGET=y
BR2_PACKAGE_WIRELESS_TOOLS=y
BR2_PACKAGE_WPA_SUPPLICANT=y
BR2_PACKAGE_WPA_SUPPLICANT_EAP=y
BR2_PACKAGE_WPA_SUPPLICANT_WPS=y
BR2_PACKAGE_WPA_SUPPLICANT_WPA3=y
BR2_PACKAGE_WPA_SUPPLICANT_CLI=y
BR2_PACKAGE_WPA_SUPPLICANT_WPA_CLIENT_SO=y
BR2_PACKAGE_WPA_SUPPLICANT_PASSPHRASE=y
BR2_PACKAGE_SUDO=y
BR2_PACKAGE_HTOP=y
BR2_PACKAGE_KMOD_TOOLS=y
BR2_PACKAGE_SUPERVISOR=y
BR2_PACKAGE_UTIL_LINUX_AGETTY=y
BR2_PACKAGE_UTIL_LINUX_FSCK=y
BR2_PACKAGE_UTIL_LINUX_MOUNT=y
BR2_TARGET_ROOTFS_EXT2=y
BR2_TARGET_ROOTFS_EXT2_4=y
BR2_TARGET_ROOTFS_EXT2_SIZE="1G"
# BR2_TARGET_ROOTFS_TAR is not set
BR2_PACKAGE_HOST_DOSFSTOOLS=y
BR2_PACKAGE_HOST_GENIMAGE=y
BR2_PACKAGE_HOST_MTOOLS=y
```

## package/despinassy/Config.in
```kconfig
config BR2_PACKAGE_DESPINASSY
    bool "despinassy"
    depends on BR2_PACKAGE_PYTHON3
    select BR2_PACKAGE_PYTHON_FLASK_SQLALCHEMY
    select BR2_PACKAGE_PYTHON_FLASK_SCRIPT
    select BR2_PACKAGE_PYTHON_SQLALCHEMY_UTILS
    help
        Sprtch Database Schema collection and shared library repository
```

## package/erie/Config.in
```kconfig
config BR2_PACKAGE_ERIE
    bool "erie"
    depends on BR2_PACKAGE_PYTHON3
    depends on BR2_PACKAGE_REDIS
    select BR2_PACKAGE_PYTHON_REDIS
    select BR2_PACKAGE_PYTHON_EVDEV
    select BR2_PACKAGE_PYTHON_EVDEV
    select BR2_PACKAGE_PYTHON_SERIAL
    select BR2_PACKAGE_DESPINASSY
    help
        Sprtch barcode scanner interface.
```

## package/huron/Config.in
```kconfig
config BR2_PACKAGE_HURON
    bool "huron"
    depends on BR2_PACKAGE_PYTHON3
    depends on BR2_PACKAGE_REDIS
    depends on BR2_PACKAGE_NGINX
    select BR2_PACKAGE_PYTHON_REDIS
    select BR2_PACKAGE_PYTHON_FLASK
    select BR2_PACKAGE_PYTHON_FLASK_SQLALCHEMY
    select BR2_PACKAGE_PYTHON_FLASK_SCRIPT
    select BR2_PACKAGE_PYTHON_GUNICORN
    select BR2_PACKAGE_PYTHON_SQLALCHEMY_UTILS
    select BR2_PACKAGE_PYTHON_PSYCOPG2
    select BR2_PACKAGE_PYTHON_FLASK_EXECUTOR
    help
        Sprtch printer web page.
```

## package/python-flask-executor/Config.in
```kconfig
config BR2_PACKAGE_PYTHON_FLASK_EXECUTOR
	bool "python-flask-executor"
	depends on BR2_PACKAGE_PYTHON3
	help
	  Flask-Executor is an easy to use wrapper for the concurrent.futures module
```

## package/python-flask-script/Config.in
```kconfig
config BR2_PACKAGE_PYTHON_FLASK_SCRIPT
	bool "python-flask-script"
	depends on BR2_PACKAGE_PYTHON3
	help
	  Flask support for writing external scripts.
```

## package/python-sqlalchemy-utils/Config.in
```kconfig
config BR2_PACKAGE_PYTHON_SQLALCHEMY_UTILS
	bool "python-sqlalchemy-utils"
	depends on BR2_PACKAGE_PYTHON3
	help
	  Various utility functions and custom data types for SQLAlchemy.
```

## package/victoria/Config.in
```kconfig
config BR2_PACKAGE_VICTORIA
    bool "victoria"
    depends on BR2_PACKAGE_PYTHON3
    depends on BR2_PACKAGE_REDIS
    select BR2_PACKAGE_PYTHON_REDIS
    select BR2_PACKAGE_DESPINASSY
    help
        Sprtch package to interface 
```
